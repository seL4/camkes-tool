## libsel4muslccamkes/Kconfig
```kconfig
#
# Copyright 2014, NICTA
#
# This software may be distributed and modified according to the terms of
# the BSD 2-Clause license. Note that NO WARRANTY is provided.
# See "LICENSE_BSD2.txt" for details.
#
# @TAG(NICTA_BSD)
#

config LIB_SEL4_MUSLC_CAMKES
    bool
    default y
    help
        Minimal Musl C backend for CAmkES.
```
