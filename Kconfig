## Kconfig
```kconfig
#
# Copyright 2017, Data61
# Commonwealth Scientific and Industrial Research Organisation (CSIRO)
# ABN 41 687 119 230.
#
# This software may be distributed and modified according to the terms of
# the BSD 2-Clause license. Note that NO WARRANTY is provided.
# See "LICENSE_BSD2.txt" for details.
#
# @TAG(DATA61_BSD)
#

menu "CAmkES Options"

    config CAMKES_DEFAULT_STACK_SIZE
    int "Component stack size"
    default 16384
    range 1 1073741824 # <-- 2^30
    help
        Stack size to allocate per-component, in bytes. Note that this value
        should be page-aligned. If not, it will be rounded up.

    config CAMKES_DEFAULT_HEAP_SIZE
    int "Component heap size"
    depends on LIB_SEL4_MUSLC_SYS_MORECORE_BYTES = 0
    default 1048576
    range 0 1073741824 # <-- 2^30
    help
        Heap size to allocate per-component, in bytes.

    config CAMKES_CPP
    bool "Pre-process with CPP"
    default n
    help
        Run CPP on the input specification(s) before parsing them into an AST.
        This can allow you to write parameterised specs in the case of more
        complex systems.

    config CAMKES_IMPORT_PATH
    string "Search path for components and interfaces"
    default ""
    help
        CAmkES can include components and interfaces stored outside the current application
        directory. This option is a space delimited list of absolute paths to directories
        to be searched for components or interfaces included with angle brackets.

    config CAMKES_DEFAULT_PRIORITY
    int "Default thread priority"
    # Default to one less than max prio to avoid interleaving our output with
    # the CapDL initialiser.
    default 254
    range 0 255
    help
        Default priority for component threads if this is not overridden via an
        attribute. Generally you want to set this as high as possible due to
        the suboptimal seL4 scheduler.

    config CAMKES_DEFAULT_AFFINITY
    int "Default thread affinity"
    # Default to 0, because 0 is the index assigned to the BSP by seL4.
    default 0
    # This should ideally be MAX_NUM_NODES-1, but the "range" keyword takes a
    # a symbol, and not an expression, and using an expression just generates
    # a build warning.
    # (https://www.kernel.org/doc/Documentation/kbuild/kconfig-language.txt)
    range 0 MAX_NUM_NODES
    help
        Default affinity for component threads if this is not overridden via an
        attribute. Think carefully when organizing your applications for
        multiprocessor operation.

    choice
    prompt "Error handling"
    default CAMKES_ERROR_HANDLER_CONFIGURABLE
    help
        Select the mode of error handling used in the glue code. It should only
        be necessary to adjust this setting if you are doing verification.
        Otherwise, the default error handling mechanism allows for
        configuration at runtime.

    config CAMKES_ERROR_HANDLER_CONFIGURABLE
    bool "Standard"
    help
        Standard error handling mechanism, that is configurable by the user at
        runtime. See the documentation for details of the API for this.

    config CAMKES_ERROR_HANDLER_GUARD
    bool "Guards"
    help
        Use verification-visible guards at the site of each potential error.
        Note that this assumes that none of the error conditions are possible.
        If you are trying to verify code, you will be forced to prove that none
        of the error conditions can ever actually occur.

    config CAMKES_ERROR_HANDLER_ABORT
    bool "Abort"
    help
        Call "abort" inline when an error occurs. For debugging purposes, this
        is probably not the behaviour you want as it will give you no
        information about the error. The standard error handling mechanism has
        a nicer default for debugging. This mode is primarily useful when you
        want to verify code whose error handlers are unreachable for
        non-trivial reasons.

    config CAMKES_ERROR_HANDLER_DISCARD
    bool "Discard"
    help
        Perform the "discard" action on any error that occurs. The advantage of
        this over simply configuring this behaviour via the standard mechanism
        is that you will not need to reason about any of the complicated error
        handling structures or control flow. This has no implementation
        advantages over the standard mechanism.

    endchoice

    config CAMKES_ALLOW_FORWARD_REFERENCES
    bool "allow forward references"
    default n
    help
        By default, you can only refer to objects in your specification which
        have been defined before the point at which you reference them.
        Selecting this option allows you to also reference objects that are
        defined below the point at which the reference occurs. This option is
        off by default because it leads to a slight performance degradation in
        parsing specifications.

    menu "Optimisation"

        choice
        prompt "Call out to objdump for ELF information"
        default CAMKES_USE_OBJDUMP_AUTO
        help
            Instead of using the internal ELF parsing functionality, it is
            possible to call out to your toolchain's objdump to perform
            required operations. This is more fragile than using internal
            functionality, but can provide a performance boost in compilation
            times. If you set this to auto (default), CAmkES will use your
            toolchain's objdump if it is in your PATH.

        config CAMKES_USE_OBJDUMP_OFF
        bool "off"
        help
            Disable the use of objdump for ELF symbol lookups. Lookups will be
            done via standard built-in CAmkES mechanisms. This may be slightly
            slower.

        config CAMKES_USE_OBJDUMP_AUTO
        bool "auto (recommended)"
        help
            Automatically detect whether objdump is available for use for ELF
            symbol lookups, and use it if so. This will result in the fastest
            available method for ELF symbol lookup being used automatically and
            is the recommended default.

        config CAMKES_USE_OBJDUMP_ON
        bool "on"
        help
            Use objdump for ELF symbol lookups. Lookups will be done by calling
            out to your toolchain's objdump binary. This is fastest at the
            expense of some robustness.

        endchoice

        config CAMKES_CACHE
        bool "Compilation cache"
        default y
        help
            Enable caching of successful code generation. With this option
            selected, CAmkES will save the output of code generation and will
            first try to satisfy new code generation requests from this cached
            information.

        config CAMKES_ACCELERATOR
        bool "Cache accelerator"
        default y
        help
            CAmkES comes with an optimised tool that can serve cached results
            from previous builds. Enabling this allows repeated builds to be
            completed without the overhead of running CAmkES itself or the
            Python interpreter. This option selects this tool for code
            generation before running CAmkES itself.

        config CAMKES_OPTIMISATION_RPC_LOCK_ELISION
        bool "RPC lock elision"
        default y
        help
            Detect when it is safe to exclude locking operations in the seL4RPC connector and
            automatically do so. This is an optimisation that can improve the performance of
            this connector.

        config CAMKES_OPTIMISATION_SPECIALISE_SYSCALL_STUBS
        bool "Specialise syscall stubs"
        default y
        help
            Detect when glue code overhead could be reduced with a custom syscall
            stub and generate and use this instead of the libsel4 stubs. This does
            not affect whether a given IPC will hit the fastpath, but it does
            reduce the userlevel overhead of these system calls. In ideal
            conditions this will give you RPC as fast as native seL4 IPC. This only
            has an effect on ARM.

        config CAMKES_LARGE_FRAME_PROMOTION
        bool "Large frame promotion"
        default y
        help
            Some hardware platforms support multiple page sizes. In components with
            large virtual address spaces, it is possible to reduce memory usage
            (and consequent load time) by backing the component's address space with
            pages of these larger sizes. When this setting is enabled, small
            consecutive page mappings will be promoted to fewer consecutive large
            mappings. Note that larger frame sizes are directly mapped into page
            directories and can also save the overhead of an accompanying page
            table.

        config CAMKES_DMA_LARGE_FRAME_PROMOTION
        bool "Large frame promotion (DMA pool)"
        default n
        help
            For components with a configured DMA pool, the frames backing this
            are not automatically promoted to large frames even if the pool is
            sufficiently large. Select this option to enable such promotion
            automatically. This is off by default because it requires support
            for large alignments in your toolchain's assembler, which is often
            absent in ARM toolchains.

        choice
        prompt "Python optimisation"
        default CAMKES_PYTHON_OPTIMISE_NONE
        help
            Select the optimisation flag to pass to the Python interpreter. The
            default is for no optimisation because profiling has suggested this
            has a detrimental effect for CAmkES. However, you may find
            different results depending on your workload.

        config CAMKES_PYTHON_OPTIMISE_NONE
        bool "None"
        help
            Do not pass any optimisation flags to the Python interpreter.

        config CAMKES_PYTHON_OPTIMISE_BASIC
        bool "-O"
        help
            Enable basic optimisations. This disables assertions and is not
            recommended if you are working on the internals of CAmkES itself.

        config CAMKES_PYTHON_OPTIMISE_MORE
        bool "-OO"
        help
            Enable basic optimisations and also strip docstrings.

        endchoice

        choice
        prompt "Python interpreter"
        default CAMKES_PYTHON_INTERPRETER_CPYTHON
        help
            Select the Python interpreter used for executing CAmkES. The default
            CPython interpreter should be acceptable for any normal use, but you
            may find PyPy provides better build system performance under some
            circumstances. To use PyPy, obviously you need it installed. The other
            interpreters are for profiling or dynamic analysis.

        config CAMKES_PYTHON_INTERPRETER_CPYTHON
        bool "CPython (default)"
        help
            Use CPython, the default Python interpreter. This is what will be
            most familiar to Python users.

        config CAMKES_PYTHON_INTERPRETER_CPYTHON2
        bool "CPython 2"
        help
            Force the use of Python 2, instead of the default Python
            executable.

        config CAMKES_PYTHON_INTERPRETER_CPYTHON3
        bool "CPython 3"
        help
            Force the use of Python 3, instead of the defauly Python
            executable. Note that Python 3 support is currently experimental
            and should not be expected to work without tweaks.

        config CAMKES_PYTHON_INTERPRETER_PYPY
        bool "PyPy"
        help
            Use PyPy, an optimised Python interpreter. PyPy is intended to be
            faster than CPython with maximum compatibility, but it is not
            recommended for use with CAmkES because profiling has indicated it
            is actually *slower* in general for CAmkES' workload.

        config CAMKES_PYTHON_INTERPRETER_FIGLEAF
        bool "Figleaf"
        help
            Use Figleaf, an interpreter that reports code coverage statistics.
            This interpreter is primarily useful for profiling or debugging
            CAmkES itself.

        config CAMKES_PYTHON_INTERPRETER_COVERAGE
        bool "Coverage"
        help
            Use Python-coverage, an interpreter that reports code coverage
            statistics. This interpreter is primarily useful for profiling or
            debugging CAmkES itself.

        endchoice

    endmenu

    menu "Profiling"

        config CAMKES_CONNECTOR_TIMING
        bool "Enable collection of timing data for connectors"
        default n
        help
            Enable timing points within connector templates that take cycle counter
            values as they are passed. This timing data can then be retrieved after
            execution.

    endmenu

    menu "Debugging"

        config CAMKES_FAULT_HANDLERS
        bool "Debugging fault handlers"
        default y
        help
            When a component references invalid virtual memory or an invalid
            capability, the access generates a fault. With this option selected
            a handler is provided that decodes this fault for debugging
            purposes. You will want to disable this in a production system or in
            a system where you want to handle your own faults.

    endmenu

    menu "Verification"

        config CAMKES_PROVIDE_TCB_CAPS
        bool "Provide TCB caps"
        default y
        help
            Hand out TCB caps to components. These caps are used by the component
            to exit cleanly by suspending. Disabling this option leaves components
            with an empty slot in place of their TCB cap. This means they will cap
            fault when attempting to exit. The advantage is that your resulting
            CapDL specification contains no TCB caps and is thus easier to reason
            about.

        config CAMKES_SUPPORT_INIT
        bool "Support init infrastructure"
        default y
        help
            Support the pre_init, post_init and interface init functions as part of
            component startup. These functions allow extra functionality, but
            introduce some endpoint caps for synchronisation. You probably want
            this option enabled unless you are targetting verification.

        config CAMKES_PRUNE_GENERATED
        bool "Prune generated C files"
        depends on BUILDSYS_CPP_SEPARATE
        default n
        help
            When selected, this option minimises the number of C functions in a
            given generated file. This can be done because the CAmkES generation
            logic knows which functions are required by the user's components and
            which are not. This option is only sensible to use in combination with
            separate pre-processing or otherwise the generated C files are already
            minimal. Note, you will need libclang-dev installed to enable this
            option.

        config CAMKES_LLVM_PATH
        string "LLVM path"
        depends on CAMKES_PRUNE_GENERATED
        help
            Path to an installation of LLVM. This is only required if you need to
            rebuild or run the pruner tool, which depends on LLVM. If LLVM and
            libclang are installed in the standard system paths you do not need to
            set this option.

        config CAMKES_THYS
        bool "Generate correctness proofs"
        default n
        help
            Generate AutoCorres-based theories of connector correctness during
            compilation.

        config CAMKES_UNIFIED_THY
        bool "Generate unified correctness proof"
        default n
        depends on CAMKES_PRUNE_GENERATED
        help
            Generate an AutoCorred-based theory combining the two glue code halves
            of a connector, resulting in a final correctness statement.

        config CAMKES_ARCH_THY
        bool "Generate architectural specification"
        default n
        help
            Generate an Isabelle theory specifying the architecture of the
            system, using the l4.verified formal model of ADL.

        config CAMKES_CIMP_THY
        bool "Generate dynamic behavioural specification"
        default n
        help
            Generate an Isabelle theory specifying the dynamic behaviour of the
            system. This theory builds on top of the CIMP formalisation.

        config CAMKES_CAPDL_THY
        bool "Generate CapDL Isabelle specification"
        default n
        help
            During a CAmkES build, a textual CapDL specification of the system
            is generated for the purpose of initialisation. Selecting this
            option causes an Isabelle version of this specification to be
            generated as well for the purposes of reasoning about the
            capability distribution of a CAmkES system.

        config CAMKES_LABEL_MAPPING
        bool "Generate policy label mapping"
        default n
        help
            Enable this option to generate a mapping from labels to kernel objects
            during compilation. A label per-CAmkES entity (component instance or
            connection) is generated and they are intended to form the input domain
            of a function mapping these to final policy labels. The final labels
            are then used to reason about the security properties of a system.

        choice
        prompt "TLS model"
        default CAMKES_TLS_STANDARD
        help
            The CAmkES glue code uses thread-local variables for marshalling and
            unmarshalling of RPC parameters. This setting controls how this thread-
            local storage is implemented.

        config CAMKES_TLS_STANDARD
        bool "standard"
        help
            Allocate thread-local variables on the stack or the heap as appropriate.
            This is the default and will hold the fewest surprises for C
            programmers.

        config CAMKES_TLS_PTG
        bool "per-thread globals"
        help
            Allocate per-thread global variables for use as thread-local storage.
            The main purpose of this implementation is to avoid taking the address
            of local variables, an idiom that cannot be handled by the verification
            C parser.

        endchoice

    endmenu

endmenu
```
